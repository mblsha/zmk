## app/boards/shields/my_keyboard/Kconfig.defconfig
```kconfig
if SHIELD_MY_KEYBOARD

config ZMK_KEYBOARD_NAME
    default "My Keyboard"

config LVGL
    default y

config ZMK_DISPLAY
    default y

endif # SHIELD_MY_KEYBOARD
```

## app/drivers/Kconfig
```kconfig
# SPDX-License-Identifier: Apache-2.0

rsource "input/Kconfig"
rsource "misc/Kconfig"
```

## app/drivers/input/Kconfig
```kconfig
# SPDX-License-Identifier: Apache-2.0

config BLACKBERRY_TRACKPAD
    bool "BlackBerry trackpad input device"
    depends on SPI && GPIO && INPUT
    help
      Enable driver for BlackBerry trackpad optical pointing device.
      This driver supports SPI-based BlackBerry trackpads commonly
      found on BlackBerry devices.
```

## app/drivers/misc/Kconfig
```kconfig
# SPDX-License-Identifier: Apache-2.0

config DRV2605
    bool "TI DRV2605 haptic motor driver"
    depends on I2C && GPIO
    help
      Enable driver for TI DRV2605 haptic motor driver.
      This driver supports both LRA (Linear Resonant Actuator)
      and ERM (Eccentric Rotating Mass) type haptic motors.

if DRV2605

config DRV2605_LOG_LEVEL
    int "Log level for DRV2605 driver"
    depends on LOG
    default 3
    range 0 4
    help
      Sets log level for DRV2605 haptic driver.
      Levels are:
      0 OFF, do not write
      1 ERROR, only write SYS_LOG_ERR
      2 WARNING, write SYS_LOG_WRN in addition to previous level
      3 INFO, write SYS_LOG_INF in addition to previous levels
      4 DEBUG, write SYS_LOG_DBG in addition to previous levels

endif # DRV2605
```

## app/dts/bindings/input/blackberry,trackpad.yaml
```yaml
# Copyright (c) 2023, My Name
# SPDX-License-Identifier: Apache-2.0

description: BlackBerry trackpad input device

compatible: "blackberry,trackpad"

include: [spi-device.yaml]

properties:
  irq-gpios:
    type: phandle-array
    description: |
      GPIO used for motion interrupt from the trackpad.
      This pin should be connected to the trackpad's motion interrupt output.

  shutdown-gpios:
    type: phandle-array
    description: |
      GPIO used to enable/disable the trackpad.
      Setting this pin low puts the trackpad in shutdown mode.

  swap-xy:
    type: boolean
    description: |
      Swap X and Y axis data.

  invert-x:
    type: boolean
    description: |
      Invert X axis data.

  invert-y:
    type: boolean
    description: |
      Invert Y axis data.

  scale-x:
    type: int
    default: 1
    description: |
      Scale factor for X axis movement. Higher values increase sensitivity.

  scale-y:
    type: int
    default: 1
    description: |
      Scale factor for Y axis movement. Higher values increase sensitivity.

  scroll-threshold:
    type: int
    default: 3
    description: |
      Minimum movement threshold to trigger scroll gesture detection.

  scroll-timeout-ms:
    type: int
    default: 200
    description: |
      Timeout in milliseconds for scroll gesture recognition.
```

## app/dts/bindings/misc/ti,drv2605.yaml
```yaml
# Copyright (c) 2023 My Name
# SPDX-License-Identifier: Apache-2.0

description: TI DRV2605 Haptic Motor Driver

compatible: "ti,drv2605"

include: [i2c-device.yaml]

properties:
  enable-gpios:
    type: phandle-array
    description: |
      GPIO used to enable the DRV2605 device.

  library:
    type: int
    default: 1
    enum:
      - 1
      - 2
      - 3
      - 4
      - 5
      - 6
      - 7
    description: |
      Waveform library to use.

  actuator-type:
    type: int
    default: 1
    enum:
      - 0 # ERM
      - 1 # LRA
    description: Type of haptic actuator.

  rated-voltage:
    type: int
    default: 2000
    description: Rated voltage of the actuator in millivolts.

  overdrive-voltage:
    type: int
    default: 2000
    description: Overdrive voltage in millivolts.

  auto-calibration:
    type: boolean
    description: Enable automatic calibration during initialization.
```
