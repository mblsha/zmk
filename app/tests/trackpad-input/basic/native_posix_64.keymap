#include "../behavior_keymap.dtsi"

&kscan {
    events = <
        /* Simulate trackpad motion events */
        /* These would normally come from the trackpad input driver */

        /* Test basic key presses first */
        ZMK_MOCK_PRESS(0,0,10)    /* Press A */
        ZMK_MOCK_RELEASE(0,0,10)  /* Release A */

        ZMK_MOCK_PRESS(1,0,10)    /* Press left click */
        ZMK_MOCK_RELEASE(1,0,10)  /* Release left click */

        /* Simulate trackpad input events */
        /* Note: In a real test, these would be generated by the input subsystem
         * from trackpad motion data. For mock testing, we simulate the resulting
         * mouse movement events directly. */
    >;
};

/* Mock trackpad input events configuration */
&bb_trackpad {
    /* In a real implementation, trackpad motion would be
     * generated by hardware interrupts and processed by
     * the BlackBerry trackpad driver */
    status = "okay";
};